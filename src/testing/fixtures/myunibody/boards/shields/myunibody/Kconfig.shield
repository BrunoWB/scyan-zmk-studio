## src/testing/fixtures/three_parts/boards/shields/three_parts/Kconfig.shield
```kconfig
config SHIELD_THREE_PARTS_DONGLE
    def_bool $(shields_list_contains,three_parts_dongle)

config SHIELD_THREE_PARTS_LEFT
    def_bool $(shields_list_contains,three_parts_left)

config SHIELD_THREE_PARTS_RIGHT
    def_bool $(shields_list_contains,three_parts_right)
```
